// SPDX-License-Identifier: GPL-2.0
/*
 * dts file for Xilinx ZynqMP SCM RevA
 *
 * (C) Copyright 2025, Advanced Micro Devices, Inc.
 *
 * Michal Simek <michal.simek@amd.com>
 */

#include "zynqmp-sc-k24-revA.dtsi"

/ {
	model = "ZynqMP SCM RevA";
	compatible = "xlnx,zynqmp-scm-revA", "xlnx,zynqmp-scm",
		     "xlnx,zynqmp";

};
